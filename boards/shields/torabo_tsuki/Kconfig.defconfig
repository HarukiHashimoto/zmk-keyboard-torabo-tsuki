## boards/shields/torabo_tsuki/Kconfig.defconfig
```kconfig
if SHIELD_TORABO_TSUKI_LEFT || SHIELD_TORABO_TSUKI_RIGHT

config ZMK_KEYBOARD_NAME
    default "torabo-tsuki"

config ZMK_SPLIT
    default y

config ZMK_NON_LIPO_BATTERY_MANAGEMENT
    default y

config SPI
    default y

config INPUT
    default y

config ZMK_MOUSE
    default y

config PMW3610
    default y

config ZMK_NON_LIPO_MIN_MV
    default 2000

config ZMK_NON_LIPO_MAX_MV
    default 3000

config ZMK_NON_LIPO_LOW_MV
    default 1900

config ZMK_NON_LIPO_ADV_SLEEP_TIMEOUT
    default 300000

endif
```
